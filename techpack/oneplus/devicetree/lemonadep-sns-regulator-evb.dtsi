#include <dt-bindings/regulator/qcom,rpmh-regulator-levels.h>
&L8C/*: pm8350c_l8: regulator-pm8350c-l8*/ {
        regulator-name = "pm8350c_l8";
        qcom,set = <RPMH_REGULATOR_SET_ALL>;
        regulator-min-microvolt = <1800000>;
        regulator-max-microvolt = <1800000>;
        regulator-always-on;
        qcom,init-voltage = <1800000>;
        qcom,init-mode = <RPMH_REGULATOR_MODE_HPM>;
};
