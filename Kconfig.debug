## drivers/soc/oplus/game_opt/Kconfig
```kconfig
config OPLUS_FEATURE_GAME_OPT
        tristate "game optimization"
        default y
        help
            game optimization support
```

## drivers/soc/oplus/healthinfo/Kconfig
```kconfig
#ifdef OPLUS_FEATURE_HEALTHINFO
config OPLUS_HEALTHINFO
bool "config healthinfo"
help
    define this config to init  healthinfo.

config OPLUS_HEALTHINFO_CPUFREQ_MAX
bool "config cpufreq max"
help
    define this config for cpufreq max.
#endif /* OPLUS_FEATURE_HEALTHINFO */
```

## drivers/soc/oplus/midas/Kconfig
```kconfig
# SPDX-License-Identifier: GPL-2.0-only
# Copyright (C) 2020-2021 Oplus. All rights reserved.

config OPLUS_FEATURE_BINDER_STATS_ENABLE
bool "config oplus midas binder stats feature"
help
	This selects midas binder stats device driver

config OPLUS_FEATURE_MIDAS_V2
tristate "config oplus midas module feature"
help
	This defines midas driver v2
```

## drivers/soc/oplus/misc/oplus_gpio/Kconfig
```kconfig
#ChenGuoyao@NETWORK.IMS 2020/06/10, Add for control oplus gpio
#change 'y' to 'n', if you want fo close this controller
config OPLUS_GPIO
    bool "oplus gpio controller"
    default n
    help
      define this config to control oplus gpio.
```
