## Kconfig.debug
```kconfig
# SPDX-License-Identifier: GPL-2.0-only
# This config refers to the generic oplus debug mode.

#ifdef CONFIG_OPLUS_SYSTEM_KERNEL
#config OPLUS_SYSTEM_KERNEL_QCOM
#  bool "config oplus system feature "
#  default y
#  help
#	define this config to Distinguish between qcom and mtk platform
#
#config OPLUS_SYSTEM_KERNEL_MTK
#  bool "config oplus system feature "
#  default n
#  help
#	define this config to Distinguish between qcom and mtk platform

config OPLUS_AGING_DEBUG
	bool "oplus aging add config"
	depends on QGKI
	select IPC_LOGGING
	select QCOM_RTB
	select QCOM_RTB_SEPARATE_CPUS
	select QCOM_RTB_QGKI
	select SCSI_LOGGING
	#select SCSI_UFSHCD_CMD_LOGGING
	select KPROBES
	select MHI_DEBUG
	select DEBUG_LIST
	select DEBUG_SPINLOCK
	select DEBUG_MUTEXES
	select SCSI_UFSHCD_CMD_LOGGING
	default y if "$(OPLUS_AGING_TEST)" = "true"
	default n

config OPLUS_KASAN_DEBUG
	bool "oplus kasan debug"
	depends on QGKI
	select KASAN
	select KASAN_GENERIC
	select SECTION_MISMATCH_WARN_ONLY
	#select KCOV
	#select KCOV_ENABLE_COMPARISONS
	default y if "$(OPLUS_KASAN_TEST)" = "true"
	default n

config OPLUS_KMEMLEAK_DEBUG
	bool "oplus kmemleak debug"
	depends on QGKI
	select DEBUG_KMEMLEAK
	select SLUB_DEBUG
	#select SLABTRACE_DEBUG
	default y if "$(OPLUS_KMEMLEAK_TEST)" = "true"
	default n

config OPLUS_SLUB_DEBUG
	bool "oplus slub debug"
	depends on QGKI
	select SLUB_DEBUG
	select SLUB_DEBUG_ON
	select SLUB_DEBUG_PANIC_ON
	default y if "$(OPLUS_SLUB_TEST)" = "true"
	default n

config OPLUS_PAGEOWNER_DEBUG
	bool "oplus pageowner debug"
	depends on QGKI
	select PAGE_OWNER
	select PAGE_OWNER_ENABLE_DEFAULT
	default y if "$(OPLUS_PAGEOWNER_TEST)" = "true"
	default n
#endif /*CONFIG_OPLUS_SYSTEM_KERNEL*/
```

## drivers/block/zram/Kconfig
```kconfig
# SPDX-License-Identifier: GPL-2.0
config ZRAM
	tristate "Compressed RAM block device support"
	depends on BLOCK && SYSFS && ZSMALLOC && CRYPTO
	select CRYPTO_LZO
	help
	  Creates virtual block devices called /dev/zramX (X = 0, 1, ...).
	  Pages written to these disks are compressed and stored in memory
	  itself. These disks allow very fast I/O and compression provides
	  good amounts of memory savings.

	  It has several use cases, for example: /tmp storage, use as swap
	  disks and maybe many more.

	  See Documentation/admin-guide/blockdev/zram.rst for more information.

config ZRAM_WRITEBACK
       bool "Write back incompressible or idle page to backing device"
       depends on ZRAM
       help
	 With incompressible page, there is no memory saving to keep it
	 in memory. Instead, write it out to backing device.
	 For this feature, admin should set up backing device via
	 /sys/block/zramX/backing_dev.

	 With /sys/block/zramX/{idle,writeback}, application could ask
	 idle page's writeback to the backing device to save in memory.

	 See Documentation/admin-guide/blockdev/zram.rst for more information.

config ZRAM_MEMORY_TRACKING
	bool "Track zRam block status"
	depends on ZRAM && DEBUG_FS
	help
	  With this feature, admin can track the state of allocated blocks
	  of zRAM. Admin could see the information via
	  /sys/kernel/debug/zram/zramX/block_state.

	  See Documentation/admin-guide/blockdev/zram.rst for more information.

config HYBRIDSWAP
	bool "Enable Hybridswap"
	depends on MEMCG && ZRAM && QGKI
	default n
	help
	  Hybridswap is a intelligent memory management solution.

config HYBRIDSWAP_SWAPD
	bool "Enable hybridswap swapd thread to reclaim anon pages in background"
	default n
	depends on HYBRIDSWAP
	help
	  swapd is a kernel thread that reclaim anonymous pages in the
	  background. When the use of swap pages reaches the watermark
	  and the refault of anonymous pages is high, the content of
	  zram will exchanged to eswap by a certain percentage.

# Selected when system need hybridswap container
config HYBRIDSWAP_CORE
	bool "Hybridswap container device support"
	depends on HYBRIDSWAP
	default n
	help
	  Say Y here if you want to use the hybridswap
	  as the backend device in ZRAM.
	  If unsure, say N here.
	  This module can't be compiled as a module,
	  the module is as one part of the ZRAM driver.

config HYBRIDSWAP_ASYNC_COMPRESS
	bool "hypbridswap support asynchronous compress anon pages"
	depends on HYBRIDSWAP
	default n
	help
	  Say Y here if you want to create asynchronous thread
	  for compress anon pages.
	  If unsure, say N here.
	  This feature will reduce the kswapd cpu load.
```

## drivers/hid/oplus_bluetooth/Kconfig
```kconfig
# SPDX-License-Identifier: GPL-2.0-only
# Copyright (C) 2020-2022 Oplus. All rights reserved.

config OPLUS_BT_BUG_STABILITY
        bool "Add for oplus bt hid bug"
        help
          Add for oplus bt hid bug.
```

## drivers/input/oplus_fp_drivers/Kconfig
```kconfig
menuconfig OPLUS_FINGERPRINT
	bool "OPLUS fingerprint"
	depends on SPI_MASTER
	help
	  Say Y here to enable OPLUS fingerprint support

if OPLUS_FINGERPRINT
### fingerprint common config
config OPLUS_FINGERPRINT_COMMON
       default n
       tristate "Fingerprint common"

### platform config
config OPLUS_FINGERPRINT_QCOM
       default n
       tristate "Fingerprint base on QCOM"

config OPLUS_FINGERPRINT_MTK
       default n
       tristate "Fingerprint base on MTK"

### fingerprint sensor config
config OPLUS_FINGERPRINT_FPC
       default n
       tristate "Fingerprint base on fpc capacitive chip"
config OPLUS_FINGERPRINT_GOODIX
       default n
       tristate "Fingerprint base on goodix capacitive chip"
config OPLUS_FINGERPRINT_GOODIX_OPTICAL
       default n
       tristate "Fingerprint base on goodix optical chip"
config OPLUS_FINGERPRINT_SILEAD_OPTICAL
       default n
       tristate "Fingerprint base on silead optical chip"
config OPLUS_FINGERPRINT_EGIS_OPTICAL
       default n
       tristate "Fingerprint base on egis optical chip"
config OPLUS_FINGERPRINT_SILEAD
       default n
       tristate "Fingerprint base on silead chip"
config OPLUS_FINGERPRINT_JIIOV_OPTICAL
       default n
       tristate "Fingerprint base on jiiov optical chip"

### fingerprint feature config
config OPLUS_FINGERPRINT_NAVIGATION_ENABLE
       default n
       tristate "Fingerprint navigation function"

endif #OPLUS_FINGERPRINT
```

## drivers/input/touchscreen/oplus_touchscreen_v2/Kconfig
```kconfig
config TOUCHPANEL_MTK_PLATFORM
    bool "OPLUS platform tp module used"
    help
      Say Y here if you have mtk-platform.

config TOUCHPANEL_LATE_INIT
    bool "mk6360 pmic init"
    help
      Say Y here if you have mk6360 pmic.

config TOUCHIRQ_UPDATE_QOS
    bool "OPLUS touchpanel driver update qos"
    help
      Say Y here if you want to update qos value in irq handler.

config TOUCHPANEL_NEW_SET_IRQ_WAKE
    bool "OPLUS platform tp module used"
    help
      Say Y here if call enable_irq_wake, can not call disable_irq_nosync

config TOUCHPANEL_OPLUS
    tristate "OPLUS tp module"
    help
      Say Y here if you have touchscreen build into driver.
      Say M here if you have touchscreen as module.

config OPLUS_MTK_DRM_GKI_NOTIFY
       default n
       tristate "tp mtk gki notify"

config OPLUS_TP_APK
    bool "OPLUS apk node create"
    help
      Say Y here if you use apk for TP.


config REMOVE_OPLUS_FUNCTION
    bool "REMOVE_OPLUS_FUNCTION"
    help
      Say Y here if you want to remove all oplus function when bring up.

config TOUCHPANEL_MULTI_NOFLASH
    bool "Multiple noflash TPs using"
    help
      Say Y here if you have multiple noflash touchscreen.

config TOUCHPANEL_NOTIFY
    tristate "touch notify"
    help
      Say Y here if you have touchscreen notify build into driver.
      Say M here if you have touchscreen notify as module.

config TOUCHPANEL_SYNAPTICS
    tristate "TP Synaptics_IC enable or not for OPLUS"
    help
    Say Y to enable driver for Touchpanel using Synaptics_IC
    Say M to enable driver for Touchpanel using Synaptics_IC as module.

config TOUCHPANEL_SAMSUNG
    tristate "TP samsung IC enable or not for OPLUS"
    ---help---
    say Y to enable driver for Touchpanel using samsung IC
    Say M to enable driver for Touchpanel using samsung IC as module.
config TOUCHPANEL_ST
	tristate "TP st IC enable or not for OPLUS"
	help
	Say Y to enable driver for Touchpanel using st IC
	Say M to enable driver for Touchpanel using st IC as module.

if TOUCHPANEL_SYNAPTICS
source "drivers/input/touchscreen/oplus_touchscreen_v2/Synaptics/Kconfig"
endif
if TOUCHPANEL_SAMSUNG
source "drivers/input/touchscreen/oplus_touchscreen_v2/Samsung/Kconfig"
endif
```

## drivers/input/touchscreen/oplus_touchscreen_v2/Samsung/S6SY792/Kconfig
```kconfig
config TOUCHPANEL_SAMSUNG_S6SY792
#   default y
    tristate "TP Samsung s6sy792 IC enable or not for OPLUS"
    ---help---
    say Y to enable driver for Touchpanel using Samsung s6sy792
```

## drivers/input/touchscreen/oplus_touchscreen_v2/St/ST80Y/Kconfig
```kconfig
config TOUCHPANEL_ST_ST80Y
#	default y
	tristate "TP ST80Y IC enable or not for OPLUS"
	help
	  Say M to enable driver for Touchpanel using ST ST80Y IC
	  Say M to enable driver for Touchpanel using ST ST80Y IC as module
```

## drivers/input/touchscreen/oplus_touchscreen_v2/Synaptics/Kconfig
```kconfig
source "drivers/input/touchscreen/oplus_touchscreen_v2/Synaptics/Syna_tcm_oncell/Kconfig"
```

## drivers/input/touchscreen/oplus_touchscreen_v2/Synaptics/Syna_tcm_oncell/Kconfig
```kconfig
#
# Synaptics TCM touchscreen driver configuration
#
config TOUCHPANEL_SYNAPTICS_TCM_ONCELL
    tristate "TP Synaptics_tcm_oncell enable or not"
    help
      Say Y here if you have a Synaptics TCM touchscreen connected
      to your system.

      If unsure, say N.
```

## drivers/input/touchscreen/st80y/Kconfig
```kconfig
config TOUCHPANEL_ST80Y
	default y
	bool "TP ST80Y enable or not for OPLUS"
	---help---
	say Y to enable driver for Touchpanel using ST80Y
```

## drivers/input/touchscreen/touch_custom/Kconfig
```kconfig
config TOUCHPANEL_CUSTOM
	tristate "custom touchscreen driver"
	help
	  Say Y here if want to add touch custom driver for the built-in touchscreen.

	  If unsure, say N.

	  To compile this driver as a module, choose M here.
```

## drivers/nfc/oplus_nfc/Kconfig
```kconfig
# SPDX-License-Identifier: GPL-2.0-only
config OPLUS_NFC
  tristate  "config oplus nfc chipset"
  help
	define this config to get chipset version from dts.
```

## drivers/nfc/st21nfc-i2c/Kconfig
```kconfig
config NFC_ST21_I2C
	tristate "ST Microelectronics ST21NFC NFC Controller Driver"
	depends on I2C
	---help---
     ST Microelectronics ST21NFC Near Field Communication controller
     support.
```

## drivers/nfc/st54-spi/Kconfig
```kconfig
config NFC_ST54_SPI
	tristate "NFC driver solution - SPI Controller Driver"
	depends on SPI && NFC_ST21_I2C
	help
	  STMicroelectronics ST54 Secure Element controller SPI interface
	  support. ST21NFC is standalone NFC and ST54 is combined with
	  secure element. If configures to be y, means devices supports SPI
	  interface to ST54. If configures to be n, means devices doesn't
	  support SPI interface (eSE still usable).
```

## drivers/power/Kconfig
```kconfig
# SPDX-License-Identifier: GPL-2.0-only
source "drivers/power/avs/Kconfig"
source "drivers/power/reset/Kconfig"
source "drivers/power/supply/Kconfig"

#ifdef OPLUS_FEATURE_CHG_BASIC
config OPLUS_CHG
	tristate "OPLUS CHARGER KO module"
	default m
	help
	  Enables support for the oplus charging framework

config OPLUS_SM8350_CHARGER
	bool "OPLUS SM8350 charger driver"
	help
	  Enables support for the sm8350 charging

config OPLUS_SHORT_C_BATT_CHECK
	bool "OPLUS_SHORT_C_BATT CHECK SUPPORT"
	default n
	help
	  Say Y to include support

config OPLUS_CALL_MODE_SUPPORT
	bool "OPLUS call mode support"
	help
	  Say Y to include support

config OPLUS_SMART_CHARGER_SUPPORT
	bool "OPLUS smart charger support"
	help
	  Say Y to include support

config OPLUS_SHORT_HW_CHECK
	bool "OPLUS_SHORT_HW CHECK SUPPORT"
	default n
	help
	  Say Y to include support

config OPLUS_CHIP_SOC_NODE
	bool "OPLUS chip soc node"
	help
	  Say Y to include support

config OPLUS_SHORT_IC_CHECK
	bool "OPLUS_SHORT_IC CHECK SUPPORT"
	default n
	help
	  Say Y to include support

config OPLUS_SHORT_USERSPACE
	bool "OPLUS batt userspace"
	help
	 Say Y to include support

config OPLUS_RTC_DET_SUPPORT
	bool "OPLUS RTC DET SUPPORT"
	default n
	help
	  Say Y to include support

config OPLUS_CHECK_CHARGERID_VOLT
	bool "OPLUS CHECK CHARGERID VOLT"
	default n
	help
	  Say Y to include support

config OPLUS_SHIP_MODE_SUPPORT
	bool "OPLUS_SHIP_MODE_SUPPORT"
	default n
	help
	  Say Y to include support
source "drivers/power/oplus/Kconfig"
#endif
```

## drivers/scsi/ufs/oplus_ufs/Kconfig
```kconfig
config OPLUS_FEATURE_UFS_DRIVER
  tristate "oplus ufs driver"
  help
    define this config to define oplus ufs driver common modify
```

## drivers/soc/Kconfig
```kconfig
# SPDX-License-Identifier: GPL-2.0-only
menu "SOC (System On Chip) specific Drivers"

source "drivers/soc/actions/Kconfig"
source "drivers/soc/amlogic/Kconfig"
source "drivers/soc/aspeed/Kconfig"
source "drivers/soc/atmel/Kconfig"
source "drivers/soc/bcm/Kconfig"
source "drivers/soc/fsl/Kconfig"
source "drivers/soc/imx/Kconfig"
source "drivers/soc/ixp4xx/Kconfig"
source "drivers/soc/mediatek/Kconfig"
source "drivers/soc/qcom/Kconfig"
source "drivers/soc/renesas/Kconfig"
source "drivers/soc/rockchip/Kconfig"
source "drivers/soc/samsung/Kconfig"
source "drivers/soc/sunxi/Kconfig"
source "drivers/soc/tegra/Kconfig"
source "drivers/soc/ti/Kconfig"
source "drivers/soc/ux500/Kconfig"
source "drivers/soc/versatile/Kconfig"
source "drivers/soc/xilinx/Kconfig"
source "drivers/soc/zte/Kconfig"
#ifdef OPLUS_FEATURE_POWERINFO_STANDBY
source "drivers/soc/oplus/oplus_wakelock/Kconfig"
#endif /* OPLUS_FEATURE_POWERINFO_STANDBY */
#ifdef VENDOR_EDIT
source "drivers/soc/oplus/system/Kconfig"
#source "drivers/soc/oplus/device_info/Kconfig"
#endif /* VENDOR_EDIT */

#ifdef OPLUS_FEATURE_TP_BASIC
source "drivers/soc/oplus/device_info/Kconfig"
#endif /* OPLUS_FEATURE_TP_BASIC */

#ifdef OPLUS_FEATURE_SENSOR_SMEM
source "drivers/soc/oplus/sensor/Kconfig"
#endif /* OPLUS_FEATURE_SENSOR_SMEM */

#ifdef OPLUS_FEATURE_THERMAL_HORAE
source "drivers/soc/oplus/thermal/Kconfig"
#endif /* OPLUS_FEATURE_THERMAL_HORAE */

#ifdef OPLUS_FEATURE_ESIM
source "drivers/soc/oplus/misc/Kconfig"
#endif /* OPLUS_FEATURE_ESIM */

#ifdef OPLUS_FEATURE_HEALTHINFO
source "drivers/soc/oplus/healthinfo/Kconfig"
#endif /* OPLUS_FEATURE_HEALTHINFO */
endmenu

#ifdef OPLUS_FEATURE_MEMLEAK_DETECT
#Add for svelte
source "drivers/soc/oplus/svelte/Kconfig"
#endif /* OPLUS_FEATURE_MEMLEAK_DETECT */

#ifdef OPLUS_FEATURE_LOWMEM_DBG
source "drivers/soc/oplus/lowmem_dbg/Kconfig"
#endif /* OPLUS_FEATURE_LOWMEM_DBG */

#ifdef OPLUS_FEATURE_MIDAS
source "drivers/soc/oplus/midas/Kconfig"
#endif

#ifdef OPLUS_FEATURE_IM
#ted.lin@optimization add for im module
source "drivers/soc/oplus/im/Kconfig"
#endif /* OPLUS_FEATURE_IM */

#ifdef OPLUS_FEATURE_CPUFREQ_BOUNCING
source "drivers/soc/oplus/cpufreq_bouncing/Kconfig"
#endif

#ifdef OPLUS_FEATURE_TPD
source "drivers/soc/oplus/tpd/Kconfig"
#endif

#Add for NandSwap
source "drivers/soc/oplus/oplus_nandswap/Kconfig"

#ifdef OPLUS_FEATURE_SUGOV_POWER_EFFIENCY
source "drivers/soc/oplus/cpufreq_effiency/Kconfig"
#endif /* OPLUS_FEATURE_SUGOV_POWER_EFFIENCY */

#ifdef OPLUS_FEATURE_OCH
source "drivers/soc/oplus/cpufreq_health/Kconfig"
#endif

#ifdef OPLUS_FEATURE_GAME_OPT
source "drivers/soc/oplus/game_opt/Kconfig"
#endif /* OPLUS_FEATURE_GAME_OPT */
```

## drivers/soc/oplus/cpufreq_health/Kconfig
```kconfig
config OPLUS_FEATURE_OCH
	tristate "cpufreq_health"
	default n
	help
		This selects cpufreq and vlotage statistics driver
```

## drivers/soc/oplus/device_info/Kconfig
```kconfig
config OPLUS_DEVICE_IFNO
  tristate "config oplus devinfo software"
  help
    define this config to compile devinfo.c for device register
```
