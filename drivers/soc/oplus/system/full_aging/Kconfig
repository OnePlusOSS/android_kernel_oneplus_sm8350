## drivers/soc/oplus/system/full_aging/Kconfig
```kconfig
# SPDX-License-Identifier: GPL-2.0-only
# Copyright (C) 2018-2020 Oplus. All rights reserved.
config OPLUS_FEATURE_AGINGTEST
  tristate "Oplus system full aging"
  default n
  help
    define this config to init oplus system full aging.
```

## drivers/soc/oplus/system/oplus_phoenix/Kconfig
```kconfig
# SPDX-License-Identifier: GPL-2.0-only
# Copyright (C) 2018-2020 Oplus. All rights reserved.
#Kun.Hu@TECH.BSP.Stability.PHOENIX_PROJECT 2019/06/15, Add for PHOENIX_PROJECT
#change 'y' to 'n', if you want fo close phoenix feature
config OPLUS_FEATURE_PHOENIX
    bool "oplus phoenix project"
    default n
    help
      define this config to init oplus phoenix project.
```

## drivers/soc/oplus/system/rt_info/Kconfig
```kconfig
config OPLUS_FEATURE_RT_OPT_INFO
	tristate "rt info stat"
	default n
	help
		Schedule info statistics for render thread
```

## drivers/soc/oplus/system/theia/Kconfig
```kconfig
# SPDX-License-Identifier: GPL-2.0-only
# Copyright (C) 2018-2020 Oplus. All rights reserved.
#Gang.Yang@TECH.BSP.Stability.THEIA_PROJECT 2019/06/15, Add for THEIA_PROJECT
#change 'y' to 'n', if you want fo close theia feature
config OPLUS_FEATURE_THEIA
    tristate "theia project"
    default n
    help
      define this config to init theia project.
```

## drivers/soc/oplus/thermal/Kconfig
```kconfig
#
# Generic thermal sysfs drivers configuration
#

config HORAE_THERMAL_SHELL
	  tristate "Horae shell temp driver"
	  default y
	  help
	    Provide three thermal zones(front, frame and back) to get real shell temp.

#ifdef OPLUS_FEATURE_DRG
source "drivers/soc/oplus/thermal/oplus_drg/Kconfig"
#endif /* OPLUS_FEATURE_DRG */
```

## drivers/soc/oplus/thermal/oplus_drg/Kconfig
```kconfig
config OPLUS_DRG
  tristate "dual rail governor"
  default n
  help
    manager frequency dependency caused by dual rail between
    different cpufreq device and devfreq device
```

## fs/proc/task_cpustats/Kconfig
```kconfig
config OPLUS_CTP
	tristate "task_cpustats"
	default n
	help
	  record cpu status
```

## kernel/sched_assist/Kconfig
```kconfig
config OPLUS_FEATURE_SCHED_ASSIST
	tristate "sched_assist"
	default n
	help
	  turning sched for ui, render and so on to improve UX
```

## mm/healthinfo/Kconfig
```kconfig
config OPLUS_MEM_MONITOR
	bool "memory monitor "
	default n
	help
	 memory monitor.
```

## net/oplus_connectivity_dhcp/Kconfig
```kconfig
# SPDX-License-Identifier: GPL-2.0-only
# Copyright (C) 2020-2022 Oplus. All rights reserved.

config OPLUS_FEATURE_WIFI_DHCP
	tristate "Add for Dhcp conflict"
	help
	  Add for Dhcp conflict.
```

## net/oplus_connectivity_luckymoney/Kconfig
```kconfig
# SPDX-License-Identifier: GPL-2.0-only
# Copyright (C) 2020-2022 Oplus. All rights reserved.

config OPLUS_FEATURE_WIFI_LUCKYMONEY
	tristate "Add for WeChat lucky money recognition"
	help
	  Add for WeChat lucky money recognition.
```

## net/oplus_nwpower/Kconfig
```kconfig
# SPDX-License-Identifier: GPL-2.0-only
# Copyright (C) 2020-2022 Oplus. All rights reserved.

config OPLUS_FEATURE_NWPOWER
        tristate "Add for oplus nwpower function"
        help
          Add for oplus nwpower function.
```

## net/oplus_sla/Kconfig
```kconfig
# SPDX-License-Identifier: GPL-2.0-only
# Copyright (C) 2020-2022 Oplus. All rights reserved.

config OPLUS_FEATURE_WIFI_SLA
	bool "Add for oplus sla function"
	help
	  Add for oplus sla function.
```

## net/oplus_wifi_wsa/Kconfig
```kconfig
# SPDX-License-Identifier: GPL-2.0-only
# Copyright (C) 2020-2022 Oplus. All rights reserved.

config OPLUS_FEATURE_WIFI_SMARTANTENNA
	bool "Add for oplus wifi smart antenna function"
	help
	  Add for oplus wifi ant function.
```
