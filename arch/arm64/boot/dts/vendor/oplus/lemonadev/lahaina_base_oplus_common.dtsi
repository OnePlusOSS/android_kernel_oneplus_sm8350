
/ {
	oplus,dtsi_no = <19825 19815 20854 133210>;
	aliases {
		/* #ifdef OPLUS_ARCH_EXTENDS */
		i2c4 = &qupv3_se19_i2c;
		/* #endif OPLUS_ARCH_EXTENDS  */
	};
    chosen {
        //#ifdef OPLUS_BSP_BOOTFLOW
        bootargs = "log_buf_len=1M earlycon=msm_geni_serial,0x98c000 rcupdate.rcu_expedited=1 rcu_nocbs=0-7";
        //#endif
        //bootargs = "log_buf_len=256K earlycon=msm_geni_serial,0x98c000 rcupdate.rcu_expedited=1 rcu_nocbs=0-7";
    };
};
