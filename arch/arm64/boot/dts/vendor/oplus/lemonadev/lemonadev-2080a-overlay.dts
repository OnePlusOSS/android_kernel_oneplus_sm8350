#include "../../qcom/lahaina-mtp-overlay.dts"
#include "lahaina_overlay_oplus_common.dtsi"
#include "lahaina_overlay_oplus_common_pinctrl.dtsi"
#include "lemonade_common.dtsi"
#include "lemonadev-2080a.dtsi"
#include "../../qcom/camera/lahaina-oem-camera-lemonade_t0.dtsi"
/ {
    model = "Qualcomm Technologies, Inc. Lahaina MTP lemonadev";
    /*we can add project id to this array,uefi can auto read it,if new project,we add to this array */
    oplus,dtsi_no = <19825 19815 20854>;
    oem,project-id = <0x20854 0x2080A 0x20852 0x20853 0x20851>; /*8350 use hex*/
    oem,project-codename = "lemonadet","lemonadev","lemonade";
    /*we can add hw id to this array,uefi can auto read it,if new hw,we add to this array  */
    oem,hw-id = <11 12 13 21 22 23 31 32 33>;
};
